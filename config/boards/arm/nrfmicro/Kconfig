## config/boards/arm/nrfmicro/Kconfig
```kconfig
config BOARD_ENABLE_DCDC
	bool "Enable DCDC mode"
	select SOC_DCDC_NRF52X
	default y
	depends on (BOARD_NRFMICRO || BOARD_NRFMICRO33)

config BOARD_NRFMICRO_CHARGER
	bool "Enable battery charger"
	default y
	depends on (BOARD_NRFMICRO_1_3_0 || BOARD_NRFMICRO_1_4_0 || BOARD_NRFMICRO33_1_4_0)
```

## config/boards/arm/nrfmicro/Kconfig.board
```kconfig
# nrfmicro board configuration

# Copyright (c) 2022 The ZMK Contributors
# SPDX-License-Identifier: MIT


config BOARD_NRFMICRO
	bool "nrfmicro"
	depends on SOC_NRF52840_QIAA

config BOARD_NRFMICRO_1_3_0
	bool "nrfmicro_1_3_0"
	depends on BOARD_NRFMICRO

config BOARD_NRFMICRO_1_4_0
	bool "nrfmicro_1_4_0"
	depends on BOARD_NRFMICRO

config BOARD_NRFMICRO33
	bool "nrfmicro33"
	depends on SOC_NRF52833_QIAA

config BOARD_NRFMICRO33_1_4_0
	bool "nrfmicro33_1_4_0"
	depends on BOARD_NRFMICRO33
```

## config/boards/arm/nrfmicro/Kconfig.defconfig
```kconfig
# Electronut Labs Papyr board configuration

# Copyright (c) 2020 The ZMK Contributors
# SPDX-License-Identifier: MIT

if (BOARD_NRFMICRO || BOARD_NRFMICRO33)

if BOARD_NRFMICRO
config BOARD
	default "nrfmicro"
endif

if BOARD_NRFMICRO33
config BOARD
	default "nrfmicro33"
endif

if USB

config USB_NRFX
	default y

config USB_DEVICE_STACK
	default y

endif # USB

config BT_CTLR
	default BT

config ZMK_BLE
	default y

config ZMK_USB
	default y

config PINMUX
	default y

config ZMK_BATTERY_VOLTAGE_DIVIDER
	default y

config BOARD_NRFMICRO_CHARGER
	default y

endif # BOARD_NRFMICRO || BOARD_NRFMICRO33
```

## config/boards/arm/stemcell/Kconfig.board
```kconfig
# STeMCell board configuration

# Copyright (c) 2021 Mega Mind
# SPDX-License-Identifier: MIT

config BOARD_STEMCELL
	bool "STeMCell"
	depends on SOC_STM32F401XC
```

## config/boards/arm/stemcell/Kconfig.defconfig
```kconfig
# STeMCell board configuration

# Copyright (c) 2021 Mega Mind
# SPDX-License-Identifier: MIT

if BOARD_STEMCELL

config BOARD
	default "stemcell"

config ZMK_USB
	default y

config SERIAL
	default y

config UART_ASYNC_API
	default y

endif # BOARD_STEMCELL
```

## config/boards/arm/stemcell/stemcell_defconfig
```kconfig
# SPDX-License-Identifier: MIT
# Copyright (c) 2021 Mega Mind

CONFIG_SOC_SERIES_STM32F4X=y
CONFIG_SOC_STM32F401XC=y

# 168MHz system clock
CONFIG_SYS_CLOCK_HW_CYCLES_PER_SEC=84000000

# MPU Settings
CONFIG_ARM_MPU=y

# enable pinmux
CONFIG_PINMUX=y

# enable GPIO
CONFIG_GPIO=y

# Code partition
CONFIG_USE_DT_CODE_PARTITION=y

# clock configuration
CONFIG_CLOCK_CONTROL=y

# Clock configuration for Cube Clock control driver
CONFIG_CLOCK_STM32_HSE_CLOCK=8000000
CONFIG_CLOCK_STM32_SYSCLK_SRC_PLL=y

# use HSE as PLL input
CONFIG_CLOCK_STM32_PLL_SRC_HSE=y

# Should be equal to HSE value
CONFIG_CLOCK_STM32_PLL_M_DIVISOR=8
CONFIG_CLOCK_STM32_PLL_N_MULTIPLIER=336
CONFIG_CLOCK_STM32_PLL_P_DIVISOR=4
CONFIG_CLOCK_STM32_PLL_Q_DIVISOR=7

CONFIG_CLOCK_STM32_AHB_PRESCALER=1
CONFIG_CLOCK_STM32_APB1_PRESCALER=2
CONFIG_CLOCK_STM32_APB2_PRESCALER=1

# disable polling for both direct and matrix
CONFIG_ZMK_KSCAN_MATRIX_POLLING=y
CONFIG_ZMK_KSCAN_DIRECT_POLLING=y
```

## config/boards/shields/lily/Kconfig.shield
```kconfig
# Copyright (c) 2020 Pete Johanson
# SPDX-License-Identifier: MIT

config SHIELD_LILY_LEFT
	def_bool $(shields_list_contains,lily_left)

config SHIELD_LILY_RIGHT
	def_bool $(shields_list_contains,lily_right)
```

## config/west.yml
```yaml
manifest:
  remotes:
    - name: zmkfirmware
      url-base: https://github.com/zmkfirmware
    - name: pete
      url-base: https://github.com/petejohanson
    - name: megamind
      url-base: https://github.com/megamind4089
  projects:
    - name: zmk
      remote: megamind
      revision: sensor_debug
      import: app/west.yml
  self:
    path: config
```
